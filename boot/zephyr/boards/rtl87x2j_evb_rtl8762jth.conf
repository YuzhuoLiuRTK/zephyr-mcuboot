## boot/zephyr/boards/rtl87x2j_evb_rtl8762jth.conf
```kconfig
# Copyright (c) 2026 Realtek Semiconductor Corporation
# SPDX-License-Identifier: Apache-2.0

CONFIG_BOOT_MAX_IMG_SECTORS_AUTO=n
CONFIG_BOOT_MAX_IMG_SECTORS=343
```
